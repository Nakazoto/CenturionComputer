* Label naming:
* ENTRY = Main entry point
* ENTnn = Additional entry point
* B = Byte
* D = Displaced branch/jump target
* F = Function JSR target
* I = 32-bit integer
* J = Jump target
* L = Label (generic)
* N = Bignum
* P = Pointer
* S = String
* W = Word
*
8000:      HLT              ; [Halt]
*
* Function ENTRY
*
8001:ENTRY CLA              ; [Clear A]
8002:      STA/  X'B800'    ; =0xb800 =47104(-18432) ='8',NUL [Store A direct]
8005:      DI               ; [Disable interrupt system]
8006:      DLY              ; [Delay 4.55 ms]
8007:      STAB/ X'F14F'    ; =0xf14f =61775(-3761) [Store AL direct]
800a:      STAB/ X'F20D'    ; =0xf20d =61965(-3571) [Store AL direct]
800d:      STAB/ X'F20F'    ; =0xf20f =61967(-3569) [Store AL direct]
8010:      LDA=  X'C000'    ; =0xc000 =49152(-16384) ='@',NUL [Load A with immediate]
8013:      XAS              ; [Transfer A to S]
8014:      CLRB  BL,2       ; [Set BL to 2]
8016:      BZ    D8023      ; =+11 [Branch if zero]
8018:      LDA=  X'8077'    ; =0x8077 =32887(-32649) [Load A with immediate]
801b:      STA/  X'00FE'    ; =0x00fe =254 =NUL,'~' [Store A direct]
801e:      CLA              ; [Clear A]
801f:      STA/  X'00FC'    ; =0x00fc =252 =NUL,'|' [Store A direct]
8022:      EPE              ; [Enable parity error]
8023:D8023 CLA              ; [Clear A]
8024:      STAB/ X'F109'    ; =0xf109 =61705(-3831) [Store AL direct]
8027:      STAB/ X'F10B'    ; =0xf10b =61707(-3829) [Store AL direct]
802a:      STAB/ X'F10D'    ; =0xf10d =61709(-3827) [Store AL direct]
802d:      STAB/ X'F10F'    ; =0xf10f =61711(-3825) [Store AL direct]
8030:      LDAB/ X'F110'    ; =0xf110 =61712(-3824) [Load AL direct]
8033:      LDBB= X'0F'      ; =15 [Load BL with immediate]
8035:      ANDB  BL,AL      ; [BL & AL -> AL]
8037:      STAB/ X'F110'    ; =0xf110 =61712(-3824) [Store AL direct]
803a:      STAB/ X'F106'    ; =0xf106 =61702(-3834) [Store AL direct]
803d:      LDBB= X'0D'      ; =13 [Load BL with immediate]
803f:      SABB             ; [AL - BL -> BL]
8040:      BNZ   D8045      ; =+3 [Branch if not zero]
8042:      JMP/  X'8728'    ; =0x8728 =34600(-30936) [Jump direct]
8045:D8045 LDBB/ X'F110'    ; =0xf110 =61712(-3824) [Load BL direct]
8048:      BM    ENTRY      ; =-73 [Branch on minus]
804a:      SLA              ; [Left shift A]
804b:      LDB=  X'8055'    ; =0x8055 =32853(-32683) [Load B with immediate]
804e:      AAB              ; [A + B -> B]
804f:      LDA+  B          ; [Load A from address in B]
8050:      STAB/ X'F108'    ; =0xf108 =61704(-3832) [Store AL direct]
8053:      JMP+  A          ; [Jump indexed, direct]
*
8055:      DW    X'8001'    ; =0x8001 =32769(-32767)
8057:      DW    X'808E'    ; =0x808e =32910(-32626)
8059:      DW    X'811B'    ; =0x811b =33051(-32485)
805b:      DW    X'8183'    ; =0x8183 =33155(-32381)
805d:      DB    X'81'      ; =0x81 =129(-127)
805e:      DC    '\'        ; hex:dc dec:220(-36)
805f:      DW    X'8203'    ; =0x8203 =33283(-32253)
8061:      DW    X'8247'    ; =0x8247 =33351(-32185)
8063:      DW    X'8284'    ; =0x8284 =33412(-32124)
8065:      DB    X'82'      ; =0x82 =130(-126)
8066:      DC    'c'        ; hex:e3 dec:227(-29)
8067:      DW    X'837F'    ; =0x837f =33663(-31873)
8069:      DW    X'846F'    ; =0x846f =33903(-31633)
806b:      DW    X'859D'    ; =0x859d =34205(-31331)
806d:      DB    X'86'      ; =0x86 =134(-122)
806e:      DC    '2'        ; hex:b2 dec:178(-78)
806f:      DW    X'8728'    ; =0x8728 =34600(-30936)
8071:      DW    X'8001'    ; =0x8001 =32769(-32767)
8073:      DW    X'8001'    ; =0x8001 =32769(-32767)
*
8075:D8075 JMP   ENTRY      ; =-118 [Jump relative]
8077:      SLAB             ; [Left shift AL]
8078:      SLAB             ; [Left shift AL]
8079:      SLAB             ; [Left shift AL]
807a:      SLAB             ; [Left shift AL]
807b:      LDBB= X'0F'      ; =15 [Load BL with immediate]
807d:      AABB             ; [AL + BL -> BL]
807e:      STBB/ X'F110'    ; =0xf110 =61712(-3824) [Store BL direct]
8081:      STAB/ X'F10C'    ; =0xf10c =61708(-3828) [Store AL direct]
8084:      STAB/ X'F10B'    ; =0xf10b =61707(-3829) [Store AL direct]
8087:      STAB/ X'F106'    ; =0xf106 =61702(-3834) [Store AL direct]
808a:      CLA              ; [Clear A]
808b:      JMP/  X'0000'    ; =0x0000 =0 =NUL,NUL [Jump direct]
808e:D808E CLR   X          ; [Clear X]
8090:D8090 LDBB= X'11'      ; =17 [Load BL with immediate]
8092:      DMA   SCT,X      ; [Store X register to DMA count register]
8094:      DMA   RCT,A      ; [Read DMA count register to A register]
8096:      SUB   X,A        ; [X - A -> A]
8098:      BNZ   D80DD      ; =+67 [Branch if not zero]
809a:      LDBB= X'21'      ; =33 [Load BL with immediate]
809c:      DMA   SAD,X      ; [Store X register to DMA address register]
809e:      DMA   RAD,A      ; [Read DMA address register to A register]
80a0:      SUB   X,A        ; [X - A -> A]
80a2:      BNZ   D80DD      ; =+57 [Branch if not zero]
80a4:      INRB  XL         ; [Increment XL by 1]
80a6:      INRB  XU         ; [Increment XU by 1]
80a8:      BNZ   D8090      ; =-26 [Branch if not zero]
80aa:      LDA=  X'0012'    ; =0x0012 =18 [Load A with immediate]
80ad:      XAY              ; [Transfer A to Y]
80ae:D80AE XFR   Y,A        ; [Transfer Y to A]
80b0:      STA+  Y          ; [Store A to address in Y]
80b1:      INRB  YL         ; [Increment YL by 1]
80b3:      INRB  YL         ; [Increment YL by 1]
80b5:      BNZ   D80AE      ; =-9 [Branch if not zero]
80b7:      LDA=  X'0012'    ; =0x0012 =18 [Load A with immediate]
80ba:      XAY              ; [Transfer A to Y]
80bb:D80BB LDAB= X'A8'      ; =168(-88) ='(' [Load AL with immediate]
80bd:      SUBB  YL,AL      ; [YL - AL -> AL]
80bf:      BZ    D80C6      ; =+5 [Branch if zero]
80c1:      LDA+  Y          ; [Load A from address in Y]
80c2:      SUB   Y,A        ; [Y - A -> A]
80c4:      BNZ   D80DB      ; =+21 [Branch if not zero]
80c6:D80C6 INRB  YL         ; [Increment YL by 1]
80c8:      INRB  YL         ; [Increment YL by 1]
80ca:      BNZ   D80BB      ; =-17 [Branch if not zero]
80cc:      STAB/ X'F10A'    ; =0xf10a =61706(-3830) [Store AL direct]
80cf:D80CF LDAB/ X'F110'    ; =0xf110 =61712(-3824) [Load AL direct]
80d2:      LDBB= X'0F'      ; =15 [Load BL with immediate]
80d4:      ANDB  BL,AL      ; [BL & AL -> AL]
80d6:      DCAB             ; [Decrement AL]
80d7:      BNZ   D8075      ; =-100 [Branch if not zero]
80d9:      JMP   D808E      ; =-77 [Jump relative]
80db:D80DB LDBB= X'31'      ; =49 [Load BL with immediate]
80dd:D80DD JSR   D80E3      ; =+4 [Jump to subroutine relative]
80df:      JMP   D80CF      ; =-18 [Jump relative]
80e1:D80E1 JMP   D8075      ; =-110 [Jump relative]
80e3:D80E3 STBB/ X'F110'    ; =0xf110 =61712(-3824) [Store BL direct]
80e6:      STAB/ X'F10B'    ; =0xf10b =61707(-3829) [Store AL direct]
80e9:      STAB/ X'F10C'    ; =0xf10c =61708(-3828) [Store AL direct]
80ec:      LDAB/ X'F110'    ; =0xf110 =61712(-3824) [Load AL direct]
80ef:      SLAB             ; [Left shift AL]
80f0:      BM    D8112      ; =+32 [Branch on minus]
80f2:      STAB/ X'F107'    ; =0xf107 =61703(-3833) [Store AL direct]
80f5:      LDA=  X'0064'    ; =0x0064 =100 [Load A with immediate]
80f8:D80F8 DLY              ; [Delay 4.55 ms]
80f9:      DCA              ; [Decrement A]
80fa:      BNZ   D80F8      ; =-4 [Branch if not zero]
80fc:      STAB/ X'F106'    ; =0xf106 =61702(-3834) [Store AL direct]
80ff:      LDA=  X'0064'    ; =0x0064 =100 [Load A with immediate]
8102:D8102 DLY              ; [Delay 4.55 ms]
8103:      DCA              ; [Decrement A]
8104:      BNZ   D8102      ; =-4 [Branch if not zero]
8106:      LDA=  X'0F00'    ; =0x0f00 =3840 [Load A with immediate]
8109:      LDAB/ X'F110'    ; =0xf110 =61712(-3824) [Load AL direct]
810c:      ANDB  AU,AL      ; [AU & AL -> AL]
810e:      BNZ   D80E3      ; =-45 [Branch if not zero]
8110:      JMP   D80E1      ; =-49 [Jump relative]
8112:D8112 LDAB/ X'F110'    ; =0xf110 =61712(-3824) [Load AL direct]
8115:      LDBB= X'0F'      ; =15 [Load BL with immediate]
8117:      NABB             ; [AL & BL -> BL]
8118:      BZ    D80E1      ; =-57 [Branch if zero]
811a:      RSR              ; [Return from subroutine]
*
811b:D811B LDA=  X'8171'    ; =0x8171 =33137(-32399) [Load A with immediate]
811e:      STA/  X'00FE'    ; =0x00fe =254 =NUL,'~' [Store A direct]
8121:      LDA=  X'0F00'    ; =0x0f00 =3840 [Load A with immediate]
8124:      LDAB/ X'F110'    ; =0xf110 =61712(-3824) [Load AL direct]
8127:      ANDB  AU,AL      ; [AU & AL -> AL]
8129:      DCAB             ; [Decrement AL]
812a:      DCAB             ; [Decrement AL]
812b:      BNZ   D80E1      ; =-76 [Branch if not zero]
812d:      LDA=  X'0100'    ; =0x0100 =256 [Load A with immediate]
8130:D8130 XAB              ; [Transfer A to B]
8131:      BM    D8139      ; =+6 [Branch on minus]
8133:      STB+  A+         ; [Store B indexed, direct, post-incremented]
8135:      JMP   D8130      ; =-7 [Jump relative]
*
* Function F8137
*
8137:F8137 JMP   D80E3      ; =-86 [Jump relative]
8139:D8139 LDA=  X'0100'    ; =0x0100 =256 [Load A with immediate]
813c:D813C LDB+  A          ; [Load B from address in A]
813d:      SAB              ; [A - B -> B]
813e:      BNZ   D8166      ; =+38 [Branch if not zero]
8140:      INA              ; [Increment A]
8141:      INA              ; [Increment A]
8142:      BP    D813C      ; =-8 [Branch on plus]
8144:      LDA=  X'0100'    ; =0x0100 =256 [Load A with immediate]
8147:      XAY              ; [Transfer A to Y]
8148:D8148 XFR   Y,A        ; [Transfer Y to A]
814a:      IVA              ; [Invert A]
814b:      STA+  Y+         ; [Store A indexed, direct, post-incremented]
814d:      XFR   Y,Y        ; [Transfer Y to Y]
814f:      BP    D8148      ; =-9 [Branch on plus]
8151:      LDA=  X'0100'    ; =0x0100 =256 [Load A with immediate]
8154:      XAY              ; [Transfer A to Y]
8155:D8155 LDA+  Y          ; [Load A from address in Y]
8156:      XAB              ; [Transfer A to B]
8157:      IVR   B          ; [Invert B]
8159:      SUB   Y,B        ; [Y - B -> B]
815b:      BNZ   D8166      ; =+9 [Branch if not zero]
815d:      LDA+  Y+         ; [Load A indexed, direct, post-incremented]
815f:      BP    D8155      ; =-12 [Branch on plus]
8161:      STAB/ X'F10A'    ; =0xf10a =61706(-3830) [Store AL direct]
8164:      JMP   D811B      ; =-75 [Jump relative]
8166:D8166 LDAB= X'F0'      ; =240(-16) ='p' [Load AL with immediate]
8168:      ANDB  AU,AL      ; [AU & AL -> AL]
816a:      INAB             ; [Increment AL]
816b:      INAB             ; [Increment AL]
816c:      XABB             ; [Transfer AL to BL]
816d:      JSR   F8137      ; =-56 [Jump to subroutine relative]
816f:      JMP   D811B      ; =-86 [Jump relative]
*
8171:      DC    '@'        ; hex:c0 dec:192(-64)
8172:      DW    X'0449'    ; =0x0449 =1097
8174:      DW    X'1403'    ; =0x1403 =5123
8176:      DW    X'7180'    ; =0x7180 =29056
8178:      DW    X'7780'    ; =0x7780 =30592
817a:      DC    'p'        ; hex:f0 dec:240(-16)
817b:      DW    X'4281'    ; =0x4281 =17025
817d:      DW    X'2828'    ; =0x2828 =10280
817f:      DW    X'4D71'    ; =0x4d71 =19825
8181:      DW    X'807E'    ; =0x807e =32894(-32642)
*
8183:D8183 LDX=  X'0010'    ; =0x0010 =16 [Load X with immediate]
8186:D8186 LDA=  X'1000'    ; =0x1000 =4096 [Load A with immediate]
8189:      ADDB  XL,AU      ; [XL + AU -> AU]
818b:      STA+  X,12       ; [Store A indexed, displaced, direct]
818e:      LDA=  X'81A3'    ; =0x81a3 =33187(-32349) [Load A with immediate]
8191:      STA+  X,14       ; [Store A indexed, displaced, direct]
8194:      LDA=  X'0010'    ; =0x0010 =16 [Load A with immediate]
8197:      ADDB  AL,XL      ; [AL + XL -> XL]
8199:      BNZ   D8186      ; =-21 [Branch if not zero]
819b:      LDA=  X'1000'    ; =0x1000 =4096 [Load A with immediate]
819e:      XFR   A,C        ; [Transfer A to C]
81a0:      RI               ; [Return from interrupt]
*
81a1:      JMP   D81A6      ; =+3 [Jump relative]
81a3:      XFR   C,X        ; [Transfer C to X]
81a5:      RI               ; [Return from interrupt]
*
81a6:D81A6 LDX=  X'0010'    ; =0x0010 =16 [Load X with immediate]
81a9:D81A9 LDA+  X,4        ; [Load A indexed, displaced, direct]
81ac:      LDAB= X'F0'      ; =240(-16) ='p' [Load AL with immediate]
81ae:      ANDB  AL,AU      ; [AL & AU -> AU]
81b0:      XFRB  XL,AL      ; [Transfer XL to AL]
81b2:      LDBB= X'10'      ; =16 [Load BL with immediate]
81b4:      ADDB  BL,AL      ; [BL + AL -> AL]
81b6:      SUBB  AL,AU      ; [AL - AU -> AU]
81b8:      BNZ   D81D1      ; =+23 [Branch if not zero]
81ba:      ADDB  BL,XL      ; [BL + XL -> XL]
81bc:      BNZ   D81A9      ; =-21 [Branch if not zero]
81be:      STAB/ X'F10A'    ; =0xf10a =61706(-3830) [Store AL direct]
81c1:      LDA=  X'0F00'    ; =0x0f00 =3840 [Load A with immediate]
81c4:      LDAB/ X'F110'    ; =0xf110 =61712(-3824) [Load AL direct]
81c7:      ANDB  AU,AL      ; [AU & AL -> AL]
81c9:      DCAB             ; [Decrement AL]
81ca:      DCAB             ; [Decrement AL]
81cb:      DCAB             ; [Decrement AL]
81cc:      BZ    D8183      ; =-75 [Branch if zero]
81ce:      JMP/  X'8001'    ; =0x8001 =32769(-32767) [Jump direct]
81d1:D81D1 XFRB  XL,AL      ; [Transfer XL to AL]
81d3:      INAB             ; [Increment AL]
81d4:      INAB             ; [Increment AL]
81d5:      INAB             ; [Increment AL]
81d6:      XABB             ; [Transfer AL to BL]
81d7:      JSR/  X'80E3'    ; =0x80e3 =32995(-32541) [Jump to subroutine direct]
81da:      JMP   D8183      ; =-89 [Jump relative]
81dc:      LDAB= X'C5'      ; =197(-59) ='E' [Load AL with immediate]
81de:      STAB/ X'F200'    ; =0xf200 =61952(-3584) ='r',NUL [Store AL direct]
81e1:D81E1 LDA=  X'0F00'    ; =0x0f00 =3840 [Load A with immediate]
81e4:      LDAB/ X'F110'    ; =0xf110 =61712(-3824) [Load AL direct]
81e7:      ANDB  AU,AL      ; [AU & AL -> AL]
81e9:      DCAB             ; [Decrement AL]
81ea:      DCAB             ; [Decrement AL]
81eb:      DCAB             ; [Decrement AL]
81ec:      DCAB             ; [Decrement AL]
81ed:      BZ    D81F2      ; =+3 [Branch if zero]
81ef:      JMP/  X'8001'    ; =0x8001 =32769(-32767) [Jump direct]
81f2:D81F2 LDAB/ X'F200'    ; =0xf200 =61952(-3584) ='r',NUL [Load AL direct]
81f5:      SRAB             ; [Arithmetic right shift AL]
81f6:      SRAB             ; [Arithmetic right shift AL]
81f7:      BNL   D81E1      ; =-24 [Branch on no link]
81f9:      LDAB= X'D5'      ; =213(-43) ='U' [Load AL with immediate]
81fb:      STAB/ X'F201'    ; =0xf201 =61953(-3583) [Store AL direct]
81fe:      JSR   F8229      ; =+41 [Jump to subroutine relative]
8200:      DB    X'04'      ; =0x04 =4
8201:      JMP   D81E1      ; =-34 [Jump relative]
8203:      LDAB= X'C5'      ; =197(-59) ='E' [Load AL with immediate]
8205:      STAB/ X'F200'    ; =0xf200 =61952(-3584) ='r',NUL [Store AL direct]
8208:D8208 LDA=  X'0F00'    ; =0x0f00 =3840 [Load A with immediate]
820b:      LDAB/ X'F110'    ; =0xf110 =61712(-3824) [Load AL direct]
820e:      ANDB  AU,AL      ; [AU & AL -> AL]
8210:      LDBB= X'05'      ; =5 [Load BL with immediate]
8212:      SABB             ; [AL - BL -> BL]
8213:      BZ    D8218      ; =+3 [Branch if zero]
8215:      JMP/  X'8001'    ; =0x8001 =32769(-32767) [Jump direct]
8218:D8218 LDAB/ X'F200'    ; =0xf200 =61952(-3584) ='r',NUL [Load AL direct]
821b:      SRAB             ; [Arithmetic right shift AL]
821c:      BNL   D8208      ; =-22 [Branch on no link]
821e:      LDAB/ X'F201'    ; =0xf201 =61953(-3583) [Load AL direct]
8221:      STAB/ X'F201'    ; =0xf201 =61953(-3583) [Store AL direct]
8224:      JSR   F8229      ; =+3 [Jump to subroutine relative]
8226:      DB    X'05'      ; =0x05 =5
8227:      JMP   D8208      ; =-33 [Jump relative]
*
* Function F8229
*
8229:F8229 LDAB/ X'F200'    ; =0xf200 =61952(-3584) ='r',NUL [Load AL direct]
822c:      LDBB= X'1C'      ; =28 [Load BL with immediate]
822e:      NABB             ; [AL & BL -> BL]
822f:      BNZ   D8236      ; =+5 [Branch if not zero]
8231:      STAB/ X'F10A'    ; =0xf10a =61706(-3830) [Store AL direct]
8234:      INX              ; [Increment X]
8235:      RSR              ; [Return from subroutine]
*
8236:D8236 XFRB  BL,AL      ; [Transfer BL to AL]
8238:      SLAB             ; [Left shift AL]
8239:      SLAB             ; [Left shift AL]
823a:      LDBB+ X+         ; [Load BL indexed, direct, post-incremented]
823c:      AABB             ; [AL + BL -> BL]
823d:      STAB/ X'F10B'    ; =0xf10b =61707(-3829) [Store AL direct]
8240:      STAB/ X'F10C'    ; =0xf10c =61708(-3828) [Store AL direct]
8243:      STBB/ X'F110'    ; =0xf110 =61712(-3824) [Store BL direct]
8246:      RSR              ; [Return from subroutine]
*
8247:      LDAB= X'C5'      ; =197(-59) ='E' [Load AL with immediate]
8249:      STAB/ X'F200'    ; =0xf200 =61952(-3584) ='r',NUL [Store AL direct]
824c:      LDAB= X'06'      ; =6 [Load AL with immediate]
824e:      STAB/ X'F20A'    ; =0xf20a =61962(-3574) [Store AL direct]
8251:      LDA=  X'826F'    ; =0x826f =33391(-32145) [Load A with immediate]
8254:      STA/  X'006E'    ; =0x006e =110 [Store A direct]
8257:      CLA              ; [Clear A]
8258:      STA/  X'006C'    ; =0x006c =108 [Store A direct]
825b:      EI               ; [Enable interrupt system]
825c:      STAB/ X'F20E'    ; =0xf20e =61966(-3570) [Store AL direct]
825f:D825F LDA=  X'0F00'    ; =0x0f00 =3840 [Load A with immediate]
8262:      LDAB/ X'F110'    ; =0xf110 =61712(-3824) [Load AL direct]
8265:      ANDB  AU,AL      ; [AU & AL -> AL]
8267:      LDBB= X'06'      ; =6 [Load BL with immediate]
8269:      SABB             ; [AL - BL -> BL]
826a:      BZ    D825F      ; =-13 [Branch if zero]
826c:      JMP/  X'8001'    ; =0x8001 =32769(-32767) [Jump direct]
826f:D826F LDAB/ X'F20F'    ; =0xf20f =61967(-3569) [Load AL direct]
8272:      BNZ   D8281      ; =+13 [Branch if not zero]
8274:      LDA/  X'F200'    ; =0xf200 =61952(-3584) ='r',NUL [Load A direct]
8277:      STAB/ X'F201'    ; =0xf201 =61953(-3583) [Store AL direct]
827a:      LDA/  X'000A'    ; =0x000a =10 [Load A direct]
827d:      XAS              ; [Transfer A to S]
827e:      JSR   F8229      ; =-87 [Jump to subroutine relative]
8280:      DB    X'06'      ; =0x06 =6
*
8281:D8281 RI               ; [Return from interrupt]
*
8282:      JMP   D826F      ; =-21 [Jump relative]
8284:      CLR   X          ; [Clear X]
8286:D8286 XFR   X,Y        ; [Transfer X to Y]
8288:      XFRB  XL,AL      ; [Transfer XL to AL]
828a:      STAB/ X'F140'    ; =0xf140 =61760(-3776) [Store AL direct]
828d:      INAB             ; [Increment AL]
828e:      STAB/ X'F141'    ; =0xf141 =61761(-3775) [Store AL direct]
8291:      INAB             ; [Increment AL]
8292:      STAB/ X'F142'    ; =0xf142 =61762(-3774) [Store AL direct]
8295:      INAB             ; [Increment AL]
8296:      STAB/ X'F143'    ; =0xf143 =61763(-3773) [Store AL direct]
8299:      LDBB/ X'F140'    ; =0xf140 =61760(-3776) [Load BL direct]
829c:      LDAB= X'07'      ; =7 [Load AL with immediate]
829e:      NABB             ; [AL & BL -> BL]
829f:      ANDB  YL,AL      ; [YL & AL -> AL]
82a1:      SABB             ; [AL - BL -> BL]
82a2:      BNZ   D82DC      ; =+56 [Branch if not zero]
82a4:      INRB  YL         ; [Increment YL by 1]
82a6:      LDBB= X'27'      ; =39 [Load BL with immediate]
82a8:      LDAB/ X'F141'    ; =0xf141 =61761(-3775) [Load AL direct]
82ab:      SUBB  YL,AL      ; [YL - AL -> AL]
82ad:      BNZ   D82DE      ; =+47 [Branch if not zero]
82af:      INRB  YL         ; [Increment YL by 1]
82b1:      LDBB= X'37'      ; =55 [Load BL with immediate]
82b3:      LDAB/ X'F142'    ; =0xf142 =61762(-3774) [Load AL direct]
82b6:      SUBB  YL,AL      ; [YL - AL -> AL]
82b8:      BNZ   D82DE      ; =+36 [Branch if not zero]
82ba:      INRB  YL         ; [Increment YL by 1]
82bc:      LDBB= X'47'      ; =71 [Load BL with immediate]
82be:      LDAB/ X'F143'    ; =0xf143 =61763(-3773) [Load AL direct]
82c1:      SUBB  YL,AL      ; [YL - AL -> AL]
82c3:      BNZ   D82DE      ; =+25 [Branch if not zero]
82c5:      LDAB= X'0F'      ; =15 [Load AL with immediate]
82c7:      LDBB/ X'F110'    ; =0xf110 =61712(-3824) [Load BL direct]
82ca:      NABB             ; [AL & BL -> BL]
82cb:      LDAB= X'07'      ; =7 [Load AL with immediate]
82cd:      SABB             ; [AL - BL -> BL]
82ce:      BZ    D82D3      ; =+3 [Branch if zero]
82d0:      JMP/  X'8001'    ; =0x8001 =32769(-32767) [Jump direct]
82d3:D82D3 INRB  XL         ; [Increment XL by 1]
82d5:      BNZ   D8286      ; =-81 [Branch if not zero]
82d7:      STAB/ X'F10A'    ; =0xf10a =61706(-3830) [Store AL direct]
82da:      JMP   D8286      ; =-86 [Jump relative]
82dc:D82DC LDBB= X'17'      ; =23 [Load BL with immediate]
82de:D82DE JSR/  X'80E3'    ; =0x80e3 =32995(-32541) [Jump to subroutine direct]
82e1:      JMP   D8286      ; =-93 [Jump relative]
82e3:D82E3 STAB/ X'F14D'    ; =0xf14d =61773(-3763) [Store AL direct]
82e6:      CLR   X          ; [Clear X]
82e8:      LDA=  X'FFFF'    ; =0xffff =65535(-1) [Load A with immediate]
82eb:      JSR   F833F      ; =+82 [Jump to subroutine relative]
82ed:      BNZ   D8333      ; =+68 [Branch if not zero]
82ef:D82EF XFR   X,A        ; [Transfer X to A]
82f1:      SLA              ; [Left shift A]
82f2:      SLA              ; [Left shift A]
82f3:      SLA              ; [Left shift A]
82f4:      SLA              ; [Left shift A]
82f5:      JSR   F833F      ; =+72 [Jump to subroutine relative]
82f7:      BNZ   D8333      ; =+58 [Branch if not zero]
82f9:      LDAB/ X'F110'    ; =0xf110 =61712(-3824) [Load AL direct]
82fc:      LDBB= X'0F'      ; =15 [Load BL with immediate]
82fe:      NABB             ; [AL & BL -> BL]
82ff:      LDAB= X'08'      ; =8 [Load AL with immediate]
8301:      SABB             ; [AL - BL -> BL]
8302:      BZ    D8307      ; =+3 [Branch if zero]
8304:      JMP/  X'8001'    ; =0x8001 =32769(-32767) [Jump direct]
8307:D8307 INX              ; [Increment X]
8308:      INX              ; [Increment X]
8309:      LDA=  X'032C'    ; =0x032c =812 [Load A with immediate]
830c:      SUB   X,A        ; [X - A -> A]
830e:      BNZ   D82EF      ; =-33 [Branch if not zero]
8310:      DCX              ; [Decrement X]
8311:      DCX              ; [Decrement X]
8312:D8312 XFR   X,A        ; [Transfer X to A]
8314:      SLA              ; [Left shift A]
8315:      SLA              ; [Left shift A]
8316:      SLA              ; [Left shift A]
8317:      SLA              ; [Left shift A]
8318:      JSR   F833F      ; =+37 [Jump to subroutine relative]
831a:      BNZ   D8333      ; =+23 [Branch if not zero]
831c:      LDAB/ X'F110'    ; =0xf110 =61712(-3824) [Load AL direct]
831f:      LDBB= X'0F'      ; =15 [Load BL with immediate]
8321:      NABB             ; [AL & BL -> BL]
8322:      LDAB= X'08'      ; =8 [Load AL with immediate]
8324:      SABB             ; [AL - BL -> BL]
8325:      BZ    D832A      ; =+3 [Branch if zero]
8327:      JMP/  X'8001'    ; =0x8001 =32769(-32767) [Jump direct]
832a:D832A DCX              ; [Decrement X]
832b:      DCX              ; [Decrement X]
832c:      BP    D8312      ; =-28 [Branch on plus]
832e:      STAB/ X'F10A'    ; =0xf10a =61706(-3830) [Store AL direct]
8331:      JMP   D82E3      ; =-80 [Jump relative]
8333:D8333 SLAB             ; [Left shift AL]
8334:      SLAB             ; [Left shift AL]
8335:      SLAB             ; [Left shift AL]
8336:      SLAB             ; [Left shift AL]
8337:      LDBB= X'08'      ; =8 [Load BL with immediate]
8339:      AABB             ; [AL + BL -> BL]
833a:      JSR/  X'80E3'    ; =0x80e3 =32995(-32541) [Jump to subroutine direct]
833d:      JMP   D82E3      ; =-92 [Jump relative]
*
* Function F833F
*
833f:F833F XAB              ; [Transfer A to B]
8340:      BP    D834D      ; =+11 [Branch on plus]
8342:      CLA              ; [Clear A]
8343:      STAB/ X'F140'    ; =0xf140 =61760(-3776) [Store AL direct]
8346:      STA/  X'F141'    ; =0xf141 =61761(-3775) [Store A direct]
8349:      LDAB= X'03'      ; =3 [Load AL with immediate]
834b:      JMP   D8356      ; =+9 [Jump relative]
834d:D834D STA/  X'F141'    ; =0xf141 =61761(-3775) [Store A direct]
8350:      CLAB             ; [Clear AL]
8351:      STAB/ X'F140'    ; =0xf140 =61760(-3776) [Store AL direct]
8354:      LDAB= X'02'      ; =2 [Load AL with immediate]
8356:D8356 STAB/ X'F148'    ; =0xf148 =61768(-3768) [Store AL direct]
8359:      LDA=  X'0190'    ; =0x0190 =400 [Load A with immediate]
835c:D835C LDB=  X'2000'    ; =0x2000 =8192 [Load B with immediate]
835f:      LDBB/ X'F145'    ; =0xf145 =61765(-3771) [Load BL direct]
8362:      ANDB  BU,BL      ; [BU & BL -> BL]
8364:      BNZ   D836E      ; =+8 [Branch if not zero]
8366:      DLY              ; [Delay 4.55 ms]
8367:      DCA              ; [Decrement A]
8368:      BNZ   D835C      ; =-14 [Branch if not zero]
836a:      LDAB= X'09'      ; =9 [Load AL with immediate]
836c:      JMP   D8373      ; =+5 [Jump relative]
836e:D836E LDAB/ X'F144'    ; =0xf144 =61764(-3772) [Load AL direct]
8371:      JSR   F8374      ; =+1 [Jump to subroutine relative]
8373:D8373 RSR              ; [Return from subroutine]
*
* Function F8374
*
8374:F8374 XABB             ; [Transfer AL to BL]
8375:      BNZ   D8378      ; =+1 [Branch if not zero]
8377:      RSR              ; [Return from subroutine]
*
8378:D8378 CLAB             ; [Clear AL]
8379:D8379 INAB             ; [Increment AL]
837a:      SRRB  BL         ; [Arithmetic right shift BL by 1]
837c:      BNL   D8379      ; =-5 [Branch on no link]
837e:      RSR              ; [Return from subroutine]
*
837f:D837F STAB/ X'F14D'    ; =0xf14d =61773(-3763) [Store AL direct]
8382:      LDA=  X'FFFF'    ; =0xffff =65535(-1) [Load A with immediate]
8385:      JSR   F833F      ; =-72 [Jump to subroutine relative]
8387:      BNZ   D83B3      ; =+42 [Branch if not zero]
8389:      LDA=  X'32BF'    ; =0x32bf =12991 [Load A with immediate]
838c:      STA/  X'F141'    ; =0xf141 =61761(-3775) [Store A direct]
838f:      LDA=  X'FE6F'    ; =0xfe6f =65135(-401) [Load A with immediate]
8392:      DMA   SCT,A      ; [Store A register to DMA count register]
8394:      LDA=  X'0100'    ; =0x0100 =256 [Load A with immediate]
8397:      DMA   SAD,A      ; [Store A register to DMA address register]
8399:      DMA   SDV,0      ; [Set DMA device]
839b:      DMA   EAB        ; [Enable DMA]
839d:      CLAB             ; [Clear AL]
839e:      STAB/ X'F148'    ; =0xf148 =61768(-3768) [Store AL direct]
83a1:      JSR/  X'8452'    ; =0x8452 =33874(-31662) [Jump to subroutine direct]
83a4:      LDBB= X'20'      ; =32 [Load BL with immediate]
83a6:      NABB             ; [AL & BL -> BL]
83a7:      BNZ   D83C2      ; =+25 [Branch if not zero]
83a9:      XABB             ; [Transfer AL to BL]
83aa:      BNZ   D83B0      ; =+4 [Branch if not zero]
83ac:      LDBB= X'A9'      ; =169(-87) =')' [Load BL with immediate]
83ae:      JMP   D83BD      ; =+13 [Jump relative]
83b0:D83B0 JSR/  X'8374'    ; =0x8374 =33652(-31884) [Jump to subroutine direct]
83b3:D83B3 STAB/ X'F14D'    ; =0xf14d =61773(-3763) [Store AL direct]
83b6:      SLAB             ; [Left shift AL]
83b7:      SLAB             ; [Left shift AL]
83b8:      SLAB             ; [Left shift AL]
83b9:      SLAB             ; [Left shift AL]
83ba:      LDBB= X'09'      ; =9 [Load BL with immediate]
83bc:      AABB             ; [AL + BL -> BL]
83bd:D83BD JSR/  X'80E3'    ; =0x80e3 =32995(-32541) [Jump to subroutine direct]
83c0:      JMP   D837F      ; =-67 [Jump relative]
83c2:D83C2 LDA=  X'8467'    ; =0x8467 =33895(-31641) [Load A with immediate]
83c5:      STA/  X'002E'    ; =0x002e =46 [Store A direct]
83c8:      CLA              ; [Clear A]
83c9:      STA/  X'002C'    ; =0x002c =44 [Store A direct]
83cc:      STAB/ X'F14F'    ; =0xf14f =61775(-3761) [Store AL direct]
83cf:      STAB/ X'F14E'    ; =0xf14e =61774(-3762) [Store AL direct]
83d2:      EI               ; [Enable interrupt system]
83d3:      LDX=  X'0001'    ; =0x0001 =1 [Load X with immediate]
83d6:D83D6 LDB=  X'0F09'    ; =0x0f09 =3849 [Load B with immediate]
83d9:      LDAB/ X'F110'    ; =0xf110 =61712(-3824) [Load AL direct]
83dc:      ANDB  BU,AL      ; [BU & AL -> AL]
83de:      SABB             ; [AL - BL -> BL]
83df:      BZ    D83E4      ; =+3 [Branch if zero]
83e1:      JMP/  X'8001'    ; =0x8001 =32769(-32767) [Jump direct]
83e4:D83E4 CLAB             ; [Clear AL]
83e5:      STAB/ X'0020'    ; =0x0020 =32 [Store AL direct]
83e8:      XFR   X,A        ; [Transfer X to A]
83ea:      JSR/  X'833F'    ; =0x833f =33599(-31937) [Jump to subroutine direct]
83ed:      BNZ   D83B3      ; =-60 [Branch if not zero]
83ef:      LDAB/ X'0020'    ; =0x0020 =32 [Load AL direct]
83f2:      BNZ   D83F8      ; =+4 [Branch if not zero]
83f4:      LDBB= X'B9'      ; =185(-71) ='9' [Load BL with immediate]
83f6:      JMP   D83BD      ; =-59 [Jump relative]
83f8:D83F8 CLAB             ; [Clear AL]
83f9:      STAB/ X'0020'    ; =0x0020 =32 [Store AL direct]
83fc:      LDA=  X'E6FF'    ; =0xe6ff =59135(-6401) [Load A with immediate]
83ff:      DMA   SCT,A      ; [Store A register to DMA count register]
8401:      LDA=  X'0100'    ; =0x0100 =256 [Load A with immediate]
8404:      DMA   SAD,A      ; [Store A register to DMA address register]
8406:      DMA   EAB        ; [Enable DMA]
8408:      CLAB             ; [Clear AL]
8409:      STAB/ X'F148'    ; =0xf148 =61768(-3768) [Store AL direct]
840c:      JSR   F8452      ; =+68 [Jump to subroutine relative]
840e:      BNZ   D83B0      ; =-96 [Branch if not zero]
8410:      LDAB/ X'0020'    ; =0x0020 =32 [Load AL direct]
8413:      BNZ   D8419      ; =+4 [Branch if not zero]
8415:      LDBB= X'C9'      ; =201(-55) ='I' [Load BL with immediate]
8417:      JMP   D83BD      ; =-92 [Jump relative]
8419:D8419 DMA   RCT,A      ; [Read DMA count register to A register]
841b:      INA              ; [Increment A]
841c:      BZ    D8422      ; =+4 [Branch if zero]
841e:      LDBB= X'D9'      ; =217(-39) ='Y' [Load BL with immediate]
8420:D8420 JMP   D83BD      ; =-101 [Jump relative]
8422:D8422 DMA   RAD,A      ; [Read DMA address register to A register]
8424:      LDB=  X'1A00'    ; =0x1a00 =6656 [Load B with immediate]
8427:      SAB              ; [A - B -> B]
8428:      BZ    D842E      ; =+4 [Branch if zero]
842a:      LDBB= X'E9'      ; =233(-23) ='i' [Load BL with immediate]
842c:      JMP   D83BD      ; =-113 [Jump relative]
842e:D842E LDA=  X'000F'    ; =0x000f =15 [Load A with immediate]
8431:      ADD   X,A        ; [X + A -> A]
8433:      LDB/  X'F141'    ; =0xf141 =61761(-3775) [Load B direct]
8436:      SAB              ; [A - B -> B]
8437:      BZ    D843D      ; =+4 [Branch if zero]
8439:      LDBB= X'F9'      ; =249(-7) ='y' [Load BL with immediate]
843b:      JMP   D8420      ; =-29 [Jump relative]
843d:D843D SLR   X          ; [Left shift X by 1]
843f:      LDAB= X'19'      ; =25 [Load AL with immediate]
8441:D8441 DLY              ; [Delay 4.55 ms]
8442:      DCAB             ; [Decrement AL]
8443:      BNZ   D8441      ; =-4 [Branch if not zero]
8445:      LDA=  X'4000'    ; =0x4000 =16384 [Load A with immediate]
8448:      SUB   X,A        ; [X - A -> A]
844a:      BNZ   D83D6      ; =-118 [Branch if not zero]
844c:      STAB/ X'F10A'    ; =0xf10a =61706(-3830) [Store AL direct]
844f:      JMP/  X'837F'    ; =0x837f =33663(-31873) [Jump direct]
*
* Function F8452
*
8452:F8452 LDA=  X'0190'    ; =0x0190 =400 [Load A with immediate]
8455:D8455 LDBB/ X'F144'    ; =0xf144 =61764(-3772) [Load BL direct]
8458:      SRRB  BL         ; [Arithmetic right shift BL by 1]
845a:      BNL   D8463      ; =+7 [Branch on no link]
845c:      DLY              ; [Delay 4.55 ms]
845d:      DCA              ; [Decrement A]
845e:      BNZ   D8455      ; =-11 [Branch if not zero]
8460:      LDAB= X'09'      ; =9 [Load AL with immediate]
8462:      RSR              ; [Return from subroutine]
*
8463:D8463 LDAB/ X'F144'    ; =0xf144 =61764(-3772) [Load AL direct]
8466:      RSR              ; [Return from subroutine]
*
8467:D8467 INRB  AU         ; [Increment AU by 1]
8469:      STAB/ X'F14F'    ; =0xf14f =61775(-3761) [Store AL direct]
846c:      RI               ; [Return from interrupt]
*
846d:      JMP   D8467      ; =-8 [Jump relative]
846f:      STA-  S-         ; [Store A indexed, pre-decremented, direct]
8471:      STAB/ X'F10A'    ; =0xf10a =61706(-3830) [Store AL direct]
8474:      STA/  X'0010'    ; =0x0010 =16 [Store A direct]
8477:      LDA=  X'0012'    ; =0x0012 =18 [Load A with immediate]
847a:      STB+  A+         ; [Store B indexed, direct, post-incremented]
847c:      STX+  A+         ; [Store X indexed, direct, post-incremented]
847e:      XFR   Y,B        ; [Transfer Y to B]
8480:      STB+  A+         ; [Store B indexed, direct, post-incremented]
8482:      XFR   Z,B        ; [Transfer Z to B]
8484:      STB+  A+         ; [Store B indexed, direct, post-incremented]
8486:      XFR   S,B        ; [Transfer S to B]
8488:      INR   B          ; [Increment B by 1]
848a:      INR   B          ; [Increment B by 1]
848c:      STB+  A+         ; [Store B indexed, direct, post-incremented]
848e:      XFR   C,B        ; [Transfer C to B]
8490:      STB+  A+         ; [Store B indexed, direct, post-incremented]
8492:      XFR   P,B        ; [Transfer P to B]
8494:      STB+  A+         ; [Store B indexed, direct, post-incremented]
8496:      LDAB= X'C5'      ; =197(-59) ='E' [Load AL with immediate]
8498:      STAB/ X'F200'    ; =0xf200 =61952(-3584) ='r',NUL [Store AL direct]
849b:      LDAB+ S+         ; [Load AL indexed, direct, post-incremented]
849d:      JSR   F8519      ; =+122 [Jump to subroutine relative]
849f:      LDAB+ S+         ; [Load AL indexed, direct, post-incremented]
84a1:      JSR   F8519      ; =+118 [Jump to subroutine relative]
84a3:D84A3 LDBB= X'5C'      ; =92 [Load BL with immediate]
84a5:      JSR   D850E      ; =+103 [Jump to subroutine relative]
84a7:      JSR   F8500      ; =+87 [Jump to subroutine relative]
84a9:      XFRB  BL,AL      ; [Transfer BL to AL]
84ab:      LDBB= X'4D'      ; =77 [Load BL with immediate]
84ad:      SABB             ; [AL - BL -> BL]
84ae:      BZ    D84E3      ; =+51 [Branch if zero]
84b0:      LDBB= X'47'      ; =71 [Load BL with immediate]
84b2:      SABB             ; [AL - BL -> BL]
84b3:      BZ    D84BF      ; =+10 [Branch if zero]
84b5:      LDBB= X'51'      ; =81 [Load BL with immediate]
84b7:      SABB             ; [AL - BL -> BL]
84b8:      BNZ   D84A3      ; =-23 [Branch if not zero]
84ba:      LDA=  X'8001'    ; =0x8001 =32769(-32767) [Load A with immediate]
84bd:      JMP   D84C3      ; =+4 [Jump relative]
84bf:D84BF JSR   F853A      ; =+121 [Jump to subroutine relative]
84c1:      XFR   Z,A        ; [Transfer Z to A]
84c3:D84C3 STA/  X'0020'    ; =0x0020 =32 [Store A direct]
84c6:      LDB=  X'001E'    ; =0x001e =30 [Load B with immediate]
84c9:      LDA+  B          ; [Load A from address in B]
84ca:      XFR   A,P        ; [Transfer A to P]
84cc:      LDA-  B-         ; [Load A indexed, pre-decremented, direct]
84ce:      XFR   A,C        ; [Transfer A to C]
84d0:      LDA-  B-         ; [Load A indexed, pre-decremented, direct]
84d2:      XAS              ; [Transfer A to S]
84d3:      LDA-  B-         ; [Load A indexed, pre-decremented, direct]
84d5:      XAZ              ; [Transfer A to Z]
84d6:      LDA-  B-         ; [Load A indexed, pre-decremented, direct]
84d8:      XAY              ; [Transfer A to Y]
84d9:      LDX-  B-         ; [Load X indexed, pre-decremented, direct]
84db:      LDB-  B-         ; [Load B indexed, pre-decremented, direct]
84dd:      LDA/  X'0010'    ; =0x0010 =16 [Load A direct]
84e0:      JMP$  X'0020'    ; =0x0020 =32 [Jump indirect]
84e3:D84E3 JSR   F853A      ; =+85 [Jump to subroutine relative]
84e5:      XFR   Z,Y        ; [Transfer Z to Y]
84e7:D84E7 LDAB+ Y          ; [Load AL from address in Y]
84e8:      JSR   F8519      ; =+47 [Jump to subroutine relative]
84ea:D84EA JSR   F853A      ; =+78 [Jump to subroutine relative]
84ec:      XFRB  ZL,AL      ; [Transfer ZL to AL]
84ee:      LDBB/ X'BF92'    ; =0xbf92 =49042(-16494) [Load BL direct]
84f1:      BZ    D84F4      ; =+1 [Branch if zero]
84f3:      STAB+ Y          ; [Store AL to address in Y]
84f4:D84F4 BNF   D84FA      ; =+4 [Branch on no fault]
84f6:      INR   Y          ; [Increment Y by 1]
84f8:      JMP   D84EA      ; =-16 [Jump relative]
84fa:D84FA BNL   D84A3      ; =-89 [Branch on no link]
84fc:      INR   Y          ; [Increment Y by 1]
84fe:      JMP   D84E7      ; =-25 [Jump relative]
*
* Function F8500
*
8500:F8500 JSR   F8557      ; =+85 [Jump to subroutine relative]
8502:      LDAB/ X'F200'    ; =0xf200 =61952(-3584) ='r',NUL [Load AL direct]
8505:      SRAB             ; [Arithmetic right shift AL]
8506:      BNL   F8500      ; =-8 [Branch on no link]
8508:      LDAB/ X'F201'    ; =0xf201 =61953(-3583) [Load AL direct]
850b:      LDBB= X'7F'      ; =127 [Load BL with immediate]
850d:      NABB             ; [AL & BL -> BL]
850e:D850E LDAB/ X'F200'    ; =0xf200 =61952(-3584) ='r',NUL [Load AL direct]
8511:      SRAB             ; [Arithmetic right shift AL]
8512:      SRAB             ; [Arithmetic right shift AL]
8513:      BNL   D850E      ; =-7 [Branch on no link]
8515:      STBB/ X'F201'    ; =0xf201 =61953(-3583) [Store BL direct]
8518:      RSR              ; [Return from subroutine]
*
* Function F8519
*
8519:F8519 JSR   F8520      ; =+5 [Jump to subroutine relative]
851b:      XFRB  AU,AL      ; [Transfer AU to AL]
851d:      JSR   F8520      ; =+1 [Jump to subroutine relative]
851f:      RSR              ; [Return from subroutine]
*
* Function F8520
*
8520:F8520 CLRB  AU         ; [Clear AU]
8522:      RRR   A          ; [Right rotate A by 1]
8524:      RRR   A          ; [Right rotate A by 1]
8526:      RRR   A          ; [Right rotate A by 1]
8528:      RRR   A          ; [Right rotate A by 1]
852a:      RRRB  AU         ; [Right rotate AU by 1]
852c:      LDBB= X'0A'      ; =10 [Load BL with immediate]
852e:      SABB             ; [AL - BL -> BL]
852f:      BM    D8536      ; =+5 [Branch on minus]
8531:      LDBB= X'37'      ; =55 [Load BL with immediate]
8533:D8533 AABB             ; [AL + BL -> BL]
8534:      JMP   D850E      ; =-40 [Jump relative]
8536:D8536 LDBB= X'30'      ; =48 [Load BL with immediate]
8538:      JMP   D8533      ; =-7 [Jump relative]
*
* Function F853A
*
853a:F853A CLA              ; [Clear A]
853b:      XAZ              ; [Transfer A to Z]
853c:      STAB/ X'BF92'    ; =0xbf92 =49042(-16494) [Store AL direct]
853f:D853F JSR   F8500      ; =-65 [Jump to subroutine relative]
8541:      JSR   F8568      ; =+37 [Jump to subroutine relative]
8543:      BP    D8546      ; =+1 [Branch on plus]
8545:      RSR              ; [Return from subroutine]
*
8546:D8546 SLR   Z          ; [Left shift Z by 1]
8548:      SLR   Z          ; [Left shift Z by 1]
854a:      SLR   Z          ; [Left shift Z by 1]
854c:      SLR   Z          ; [Left shift Z by 1]
854e:      ORIB  AL,ZL      ; [AL | ZL -> ZL]
8550:      LDAB= X'01'      ; =1 [Load AL with immediate]
8552:      STAB/ X'BF92'    ; =0xbf92 =49042(-16494) [Store AL direct]
8555:      JMP   D853F      ; =-24 [Jump relative]
*
* Function F8557
*
8557:F8557 LDAB= X'0F'      ; =15 [Load AL with immediate]
8559:      LDBB/ X'F110'    ; =0xf110 =61712(-3824) [Load BL direct]
855c:      NABB             ; [AL & BL -> BL]
855d:      LDAB= X'0A'      ; =10 [Load AL with immediate]
855f:      SABB             ; [AL - BL -> BL]
8560:      BNZ   D8563      ; =+1 [Branch if not zero]
8562:      RSR              ; [Return from subroutine]
*
8563:D8563 JMP/  X'8001'    ; =0x8001 =32769(-32767) [Jump direct]
*
* Function F8566
*
8566:F8566 JMP   D850E      ; =-90 [Jump relative]
*
* Function F8568
*
8568:F8568 XFRB  BL,AL      ; [Transfer BL to AL]
856a:      LDBB= X'30'      ; =48 [Load BL with immediate]
856c:      SABB             ; [AL - BL -> BL]
856d:      BM    D8582      ; =+19 [Branch on minus]
856f:      LDBB= X'47'      ; =71 [Load BL with immediate]
8571:      SABB             ; [AL - BL -> BL]
8572:      BP    D8592      ; =+30 [Branch on plus]
8574:      LDBB= X'40'      ; =64 [Load BL with immediate]
8576:      NABB             ; [AL & BL -> BL]
8577:      BZ    D857D      ; =+4 [Branch if zero]
8579:      LDBB= X'09'      ; =9 [Load BL with immediate]
857b:      ADDB  BL,AL      ; [BL + AL -> AL]
857d:D857D LDBB= X'0F'      ; =15 [Load BL with immediate]
857f:      ANDB  BL,AL      ; [BL & AL -> AL]
8581:      RSR              ; [Return from subroutine]
*
8582:D8582 LDBB= X'20'      ; =32 [Load BL with immediate]
8584:      SABB             ; [AL - BL -> BL]
8585:      BNZ   D8589      ; =+2 [Branch if not zero]
8587:      IVAB             ; [Invert AL]
8588:      RSR              ; [Return from subroutine]
*
8589:D8589 LDBB= X'2C'      ; =44 [Load BL with immediate]
858b:      SABB             ; [AL - BL -> BL]
858c:      BNZ   D8592      ; =+4 [Branch if not zero]
858e:      SF               ; [Set fault]
858f:      RL               ; [Reset link]
8590:      IVAB             ; [Invert AL]
8591:      RSR              ; [Return from subroutine]
*
8592:D8592 LDBB= X'0A'      ; =10 [Load BL with immediate]
8594:      JSR   F8566      ; =-48 [Jump to subroutine relative]
8596:      LDBB= X'7F'      ; =127 [Load BL with immediate]
8598:      JSR   F8566      ; =-52 [Jump to subroutine relative]
859a:      DW    X'2A2B'    ; =0x2a2b =10795
859c:      DB    X'09'      ; =0x09 =9
*
859d:      STAB/ X'F20D'    ; =0xf20d =61965(-3571) [Store AL direct]
85a0:      STAB/ X'F14D'    ; =0xf14d =61773(-3763) [Store AL direct]
85a3:      STAB/ X'F10A'    ; =0xf10a =61706(-3830) [Store AL direct]
85a6:      LDAB= X'C5'      ; =197(-59) ='E' [Load AL with immediate]
85a8:      STAB* P8623+1    ; =+122 [Store AL relative indirect]
85aa:      LDAB= X'8C'      ; =140(-116) =FF [Load AL with immediate]
85ac:      STAB/ X'F201'    ; =0xf201 =61953(-3583) [Store AL direct]
85af:      DLY              ; [Delay 4.55 ms]
85b0:      DLY              ; [Delay 4.55 ms]
85b1:D85B1 JSR   P8623      ; =+112 [Jump to subroutine relative]
85b3:      DC    'D='       ; hex:c4bd dec:50365(-67)
85b5:      DB    X'00'      ; =0x00 =0 =NUL
85b6:      JSR   D8634      ; =+124 [Jump to subroutine relative]
85b8:      LDBB= X'C8'      ; =200(-56) ='H' [Load BL with immediate]
85ba:      SABB             ; [AL - BL -> BL]
85bb:      STBB- S-         ; [Store BL indexed, pre-decremented, direct]
85bd:      BZ    D85C4      ; =+5 [Branch if zero]
85bf:      LDBB= X'C6'      ; =198(-58) ='F' [Load BL with immediate]
85c1:      SABB             ; [AL - BL -> BL]
85c2:      BNZ   D8612      ; =+78 [Branch if not zero]
85c4:D85C4 JSR   D8634      ; =+110 [Jump to subroutine relative]
85c6:      LDBB= X'50'      ; =80 [Load BL with immediate]
85c8:      ADDB  BL,AL      ; [BL + AL -> AL]
85ca:      BM    D8612      ; =+70 [Branch on minus]
85cc:      LDBB+ S+         ; [Load BL indexed, direct, post-incremented]
85ce:      BZ    D864D      ; =+125 [Branch if zero]
85d0:      LDBB= X'03'      ; =3 [Load BL with immediate]
85d2:      SABB             ; [AL - BL -> BL]
85d3:      BGZ   D8612      ; =+61 [Branch if greater than zero]
85d5:      LDB=  X'0F00'    ; =0x0f00 =3840 [Load B with immediate]
85d8:      STB-  S-         ; [Store B indexed, pre-decremented, direct]
85da:      CLR   B          ; [Clear B]
85dc:      STB-  S-         ; [Store B indexed, pre-decremented, direct]
85de:      LDBB= X'88'      ; =136(-120) [Load BL with immediate]
85e0:      STBB- S-         ; [Store BL indexed, pre-decremented, direct]
85e2:      LDB=  X'8300'    ; =0x8300 =33536(-32000) [Load B with immediate]
85e5:      STB-  S-         ; [Store B indexed, pre-decremented, direct]
85e7:      LDB=  X'8100'    ; =0x8100 =33024(-32512) [Load B with immediate]
85ea:      SL               ; [Set link]
85eb:D85EB RLRB  BL         ; [Left rotate BL by 1]
85ed:      DCAB             ; [Decrement AL]
85ee:      BP    D85EB      ; =-5 [Branch on plus]
85f0:      STB-  S-         ; [Store B indexed, pre-decremented, direct]
85f2:      DMA   SDV,1      ; [Set DMA device]
85f4:      DMA   EAB        ; [Enable DMA]
85f6:      DMA   SAD,S      ; [Store S register to DMA address register]
85f8:      LDA=  X'FFF6'    ; =0xfff6 =65526(-10) [Load A with immediate]
85fb:      DMA   SCT,A      ; [Store A register to DMA count register]
85fd:      JSR   F8621      ; =+34 [Jump to subroutine relative]
85ff:      DB    X'43'      ; =0x43 =67
8600:      LDA=  X'0100'    ; =0x0100 =256 [Load A with immediate]
8603:      DMA   SAD,A      ; [Store A register to DMA address register]
8605:      LDA=  X'F0FF'    ; =0xf0ff =61695(-3841) [Load A with immediate]
8608:      DMA   SCT,A      ; [Store A register to DMA count register]
860a:      JSR   D868A      ; =+126 [Jump to subroutine relative]
860c:      DW    X'4515'    ; =0x4515 =17685
860e:      DB    X'03'      ; =0x03 =3
*
860f:D860F JMP/  X'0103'    ; =0x0103 =259 [Jump direct]
8612:D8612 JSR   P8623      ; =+15 [Jump to subroutine relative]
8614:      DW    X'8D8A'    ; =0x8d8a =36234(-29302) =CR,LF
8616:      DC    'ERROR'    ; hex:c5d2d2cfd2
861b:      DB    X'8D'      ; =0x8d =141(-115) =CR
861c:      DW    X'8A00'    ; =0x8a00 =35328(-30208) =LF,NUL
861e:      RL               ; [Reset link]
861f:      JMP   D85B1      ; =-112 [Jump relative]
*
* Function F8621
*
8621:F8621 JMP   D868A      ; =+103 [Jump relative]
8623:P8623 LDAB/ X'F200'    ; =0xf200 =61952(-3584) ='r',NUL [Load AL direct]
8626:      SRAB             ; [Arithmetic right shift AL]
8627:      SRAB             ; [Arithmetic right shift AL]
8628:      BNL   P8623      ; =-7 [Branch on no link]
862a:      LDAB+ X+         ; [Load AL indexed, direct, post-incremented]
862c:      BNZ   P862F      ; =+1 [Branch if not zero]
862e:      RSR              ; [Return from subroutine]
*
862f:P862F STAB/ X'F201'    ; =0xf201 =61953(-3583) [Store AL direct]
8632:      JMP   P8623      ; =-17 [Jump relative]
8634:D8634 JSR   F86A3      ; =+109 [Jump to subroutine relative]
8636:      LDAB* P8623+1    ; =-20 [Load AL relative indirect]
8638:      SRAB             ; [Arithmetic right shift AL]
8639:      BNL   D8634      ; =-7 [Branch on no link]
863b:      LDAB* P862F+1    ; =-13 [Load AL relative indirect]
863d:      LDBB= X'80'      ; =128(-128) [Load BL with immediate]
863f:      ORIB  BL,AL      ; [BL | AL -> AL]
8641:      LDBB= X'E0'      ; =224(-32) ='`' [Load BL with immediate]
8643:      SABB             ; [AL - BL -> BL]
8644:      BM    D864A      ; =+4 [Branch on minus]
8646:      LDBB= X'DF'      ; =223(-33) =DEL [Load BL with immediate]
8648:      ANDB  BL,AL      ; [BL & AL -> AL]
864a:D864A STAB* P862F+1    ; =-28 [Store AL relative indirect]
864c:      RSR              ; [Return from subroutine]
*
864d:D864D LDBB= X'07'      ; =7 [Load BL with immediate]
864f:      SABB             ; [AL - BL -> BL]
8650:      BGZ   D8612      ; =-64 [Branch if greater than zero]
8652:      STAB/ X'F140'    ; =0xf140 =61760(-3776) [Store AL direct]
8655:      LDA*  P8683+1    ; =+45 [Load A relative indirect]
8657:      LDB=  X'0010'    ; =0x0010 =16 [Load B with immediate]
865a:      NAB              ; [A & B -> B]
865b:      BZ    D8612      ; =-75 [Branch if zero]
865d:      CLA              ; [Clear A]
865e:      STA/  X'F141'    ; =0xf141 =61761(-3775) [Store A direct]
8661:      JSR   F8698      ; =+53 [Jump to subroutine relative]
8663:      DB    X'03'      ; =0x03 =3
*
8664:D8664 LDA*  P8683+1    ; =+30 [Load A relative indirect]
8666:      LDB=  X'0400'    ; =0x0400 =1024 [Load B with immediate]
8669:      NAB              ; [A & B -> B]
866a:      BNZ   D8612      ; =-90 [Branch if not zero]
866c:      LDB=  X'0020'    ; =0x0020 =32 [Load B with immediate]
866f:      NAB              ; [A & B -> B]
8670:      BZ    D8664      ; =-14 [Branch if zero]
8672:      DMA   SDV,0      ; [Set DMA device]
8674:      DMA   EAB        ; [Enable DMA]
8676:      LDA=  X'0100'    ; =0x0100 =256 [Load A with immediate]
8679:      DMA   SAD,A      ; [Store A register to DMA address register]
867b:      LDA=  X'EA1F'    ; =0xea1f =59935(-5601) [Load A with immediate]
867e:      DMA   SCT,A      ; [Store A register to DMA count register]
8680:      JSR   F8698      ; =+22 [Jump to subroutine relative]
8682:      DB    X'00'      ; =0x00 =0 =NUL
8683:P8683 LDAB/ X'F144'    ; =0xf144 =61764(-3772) [Load AL direct]
8686:      BNZ   D8612      ; =-118 [Branch if not zero]
8688:      JMP   D860F      ; =-123 [Jump relative]
868a:D868A LDAB+ X+         ; [Load AL indexed, direct, post-incremented]
868c:P868C STAB/ X'F800'    ; =0xf800 =63488(-2048) ='x',NUL [Store AL direct]
868f:D868F LDAB/ X'F801'    ; =0xf801 =63489(-2047) [Load AL direct]
8692:      DCAB             ; [Decrement AL]
8693:      BNZ   D868F      ; =-6 [Branch if not zero]
8695:      LDAB* P868C+1    ; =-10 [Load AL relative indirect]
8697:      RSR              ; [Return from subroutine]
*
* Function F8698
*
8698:F8698 LDAB+ X+         ; [Load AL indexed, direct, post-incremented]
869a:      STAB/ X'F148'    ; =0xf148 =61768(-3768) [Store AL direct]
869d:D869D LDAB* P8683+1    ; =-27 [Load AL relative indirect]
869f:      SRAB             ; [Arithmetic right shift AL]
86a0:      BL    D869D      ; =-5 [Branch on link]
86a2:      RSR              ; [Return from subroutine]
*
* Function F86A3
*
86a3:F86A3 LDAB= X'0F'      ; =15 [Load AL with immediate]
86a5:      LDBB/ X'F110'    ; =0xf110 =61712(-3824) [Load BL direct]
86a8:      NABB             ; [AL & BL -> BL]
86a9:      LDAB= X'0B'      ; =11 [Load AL with immediate]
86ab:      SABB             ; [AL - BL -> BL]
86ac:      BNZ   D86AF      ; =+1 [Branch if not zero]
86ae:      RSR              ; [Return from subroutine]
*
86af:D86AF JMP/  X'8001'    ; =0x8001 =32769(-32767) [Jump direct]
86b2:D86B2 LDB=  X'0F0C'    ; =0x0f0c =3852 [Load B with immediate]
86b5:      LDAB/ X'F110'    ; =0xf110 =61712(-3824) [Load AL direct]
86b8:      ANDB  BU,AL      ; [BU & AL -> AL]
86ba:      SABB             ; [AL - BL -> BL]
86bb:      BZ    D86C0      ; =+3 [Branch if zero]
86bd:      JMP/  X'8001'    ; =0x8001 =32769(-32767) [Jump direct]
86c0:D86C0 LDX=  X'8000'    ; =0x8000 =32768(-32768) [Load X with immediate]
86c3:      CLA              ; [Clear A]
86c4:D86C4 LDAB+ X+         ; [Load AL indexed, direct, post-incremented]
86c6:      ADDB  AL,AU      ; [AL + AU -> AU]
86c8:      LDB=  X'87F9'    ; =0x87f9 =34809(-30727) =BEL,'y' [Load B with immediate]
86cb:      SUB   X,B        ; [X - B -> B]
86cd:      BNZ   D86C4      ; =-11 [Branch if not zero]
86cf:      LDAB+ X          ; [Load AL from address in X]
86d0:      SUBB  AU,AL      ; [AU - AL -> AL]
86d2:      BNZ   D871D      ; =+73 [Branch if not zero]
86d4:      LDA=  X'B800'    ; =0xb800 =47104(-18432) ='8',NUL [Load A with immediate]
86d7:      XAX              ; [Transfer A to X]
86d8:      XAY              ; [Transfer A to Y]
86d9:      LDB=  X'0400'    ; =0x0400 =1024 [Load B with immediate]
86dc:D86DC STAB+ A          ; [Store AL to address in A]
86dd:      INA              ; [Increment A]
86de:      DCR   B          ; [Decrement B by 1]
86e0:      BNZ   D86DC      ; =-6 [Branch if not zero]
86e2:      LDB=  X'0400'    ; =0x0400 =1024 [Load B with immediate]
86e5:D86E5 LDAB+ X          ; [Load AL from address in X]
86e6:      SUBB  XL,AL      ; [XL - AL -> AL]
86e8:      BNZ   D8724      ; =+58 [Branch if not zero]
86ea:      INX              ; [Increment X]
86eb:      DCR   B          ; [Decrement B by 1]
86ed:      BNZ   D86E5      ; =-10 [Branch if not zero]
86ef:      LDB=  X'0400'    ; =0x0400 =1024 [Load B with immediate]
86f2:      XFR   Y,X        ; [Transfer Y to X]
86f4:D86F4 XFRB  XL,AL      ; [Transfer XL to AL]
86f6:      IVAB             ; [Invert AL]
86f7:      STAB+ X+         ; [Store AL indexed, direct, post-incremented]
86f9:      DCR   B          ; [Decrement B by 1]
86fb:      BNZ   D86F4      ; =-9 [Branch if not zero]
86fd:      LDB=  X'0400'    ; =0x0400 =1024 [Load B with immediate]
8700:      XFR   Y,X        ; [Transfer Y to X]
8702:D8702 LDAB+ X          ; [Load AL from address in X]
8703:      IVAB             ; [Invert AL]
8704:      SUBB  XL,AL      ; [XL - AL -> AL]
8706:      BNZ   D8724      ; =+28 [Branch if not zero]
8708:      INX              ; [Increment X]
8709:      DCR   B          ; [Decrement B by 1]
870b:      BNZ   D8702      ; =-11 [Branch if not zero]
870d:      STAB/ X'F10C'    ; =0xf10c =61708(-3828) [Store AL direct]
8710:      STAB/ X'F10A'    ; =0xf10a =61706(-3830) [Store AL direct]
8713:      STAB/ X'F10E'    ; =0xf10e =61710(-3826) [Store AL direct]
8716:      LDAB= X'88'      ; =136(-120) [Load AL with immediate]
8718:      STAB/ X'F110'    ; =0xf110 =61712(-3824) [Store AL direct]
871b:      JMP   D86B2      ; =-107 [Jump relative]
871d:D871D LDBB= X'1C'      ; =28 [Load BL with immediate]
871f:D871F JSR/  X'80E3'    ; =0x80e3 =32995(-32541) [Jump to subroutine direct]
8722:      DW    X'738E'    ; =0x738e =29582
*
8724:D8724 LDBB= X'2C'      ; =44 [Load BL with immediate]
8726:      JMP   D871F      ; =-9 [Jump relative]
8728:      STAB/ X'F108'    ; =0xf108 =61704(-3832) [Store AL direct]
872b:      LDAB= X'C5'      ; =197(-59) ='E' [Load AL with immediate]
872d:      STAB/ X'F200'    ; =0xf200 =61952(-3584) ='r',NUL [Store AL direct]
8730:      DLY              ; [Delay 4.55 ms]
8731:      JSR/  X'8623'    ; =0x8623 =34339(-31197) [Jump to subroutine direct]
8734:      DW    X'8C9B'    ; =0x8c9b =35995(-29541)
8736:      DB    X'9C'      ; =0x9c =156(-100)
8737:      DC    'AUXILIARY TESTS'
8746:      DB    X'8D'      ; =0x8d =141(-115) =CR
8747:      DW    X'8A8A'    ; =0x8a8a =35466(-30070) =LF,LF
8749:      DB    X'00'      ; =0x00 =0 =NUL
874a:      LDX=  X'8800'    ; =0x8800 =34816(-30720) [Load X with immediate]
874d:      CLA              ; [Clear A]
874e:      XAY              ; [Transfer A to Y]
874f:D874F LDA+  X+         ; [Load A indexed, direct, post-incremented]
8751:      BLE   D8774      ; =+33 [Branch if less than or equal to zero]
8753:      LDB=  X'07FF'    ; =0x07ff =2047 [Load B with immediate]
8756:      SAB              ; [A - B -> B]
8757:      BGZ   D8774      ; =+27 [Branch if greater than zero]
8759:      INR   Y          ; [Increment Y by 1]
875b:      LDB=  X'F800'    ; =0xf800 =63488(-2048) ='x',NUL [Load B with immediate]
875e:      AND   X,B        ; [X & B -> B]
8760:      ADD   B,A        ; [B + A -> A]
8762:      STA-  S-         ; [Store A indexed, pre-decremented, direct]
8764:      XFR   Y,A        ; [Transfer Y to A]
8766:      JSR/  X'8519'    ; =0x8519 =34073(-31463) [Jump to subroutine direct]
8769:      LDBB= X'BD'      ; =189(-67) ='=' [Load BL with immediate]
876b:D876B JSR/  X'850E'    ; =0x850e =34062(-31474) [Jump to subroutine direct]
876e:      LDBB+ X+         ; [Load BL indexed, direct, post-incremented]
8770:      BNZ   D876B      ; =-7 [Branch if not zero]
8772:      JMP   D874F      ; =-37 [Jump relative]
8774:D8774 LDB=  X'F800'    ; =0xf800 =63488(-2048) ='x',NUL [Load B with immediate]
8777:      AND   B,X        ; [B & X -> X]
8779:      LDA=  X'0800'    ; =0x0800 =2048 [Load A with immediate]
877c:      ADD   A,X        ; [A + X -> X]
877e:      LDA=  X'F000'    ; =0xf000 =61440(-4096) ='p',NUL [Load A with immediate]
8781:      SUB   X,A        ; [X - A -> A]
8783:      BNZ   D874F      ; =-54 [Branch if not zero]
8785:      JSR/  X'8623'    ; =0x8623 =34339(-31197) [Jump to subroutine direct]
8788:      DW    X'8D8A'    ; =0x8d8a =36234(-29302) =CR,LF
878a:      DC    'ENTER TEST NUMBER:'
879c:      DB    X'00'      ; =0x00 =0 =NUL
879d:      CLR   X          ; [Clear X]
879f:D879F LDAB= X'0F'      ; =15 [Load AL with immediate]
87a1:      LDBB/ X'F110'    ; =0xf110 =61712(-3824) [Load BL direct]
87a4:      NABB             ; [AL & BL -> BL]
87a5:      LDAB= X'0D'      ; =13 [Load AL with immediate]
87a7:      SABB             ; [AL - BL -> BL]
87a8:      BZ    D87AD      ; =+3 [Branch if zero]
87aa:      JMP/  X'8001'    ; =0x8001 =32769(-32767) [Jump direct]
87ad:D87AD LDAB/ X'F200'    ; =0xf200 =61952(-3584) ='r',NUL [Load AL direct]
87b0:      SRAB             ; [Arithmetic right shift AL]
87b1:      BNL   D879F      ; =-20 [Branch on no link]
87b3:      LDBB/ X'F201'    ; =0xf201 =61953(-3583) [Load BL direct]
87b6:      LDAB= X'5F'      ; =95 [Load AL with immediate]
87b8:      SUBB  BL,AL      ; [BL - AL -> AL]
87ba:      BLE   D87BF      ; =+3 [Branch if less than or equal to zero]
87bc:      LDAB= X'DF'      ; =223(-33) =DEL [Load AL with immediate]
87be:      NABB             ; [AL & BL -> BL]
87bf:D87BF STBB/ X'F201'    ; =0xf201 =61953(-3583) [Store BL direct]
87c2:      JSR/  X'8568'    ; =0x8568 =34152(-31384) [Jump to subroutine direct]
87c5:      BM    D87D3      ; =+12 [Branch on minus]
87c7:      SLR   X          ; [Left shift X by 1]
87c9:      SLR   X          ; [Left shift X by 1]
87cb:      SLR   X          ; [Left shift X by 1]
87cd:      SLR   X          ; [Left shift X by 1]
87cf:      ORIB  AL,XL      ; [AL | XL -> XL]
87d1:      JMP   D879F      ; =-52 [Jump relative]
87d3:D87D3 XFR   X,A        ; [Transfer X to A]
87d5:      BGZ   D87DA      ; =+3 [Branch if greater than zero]
87d7:D87D7 JMP/  X'8728'    ; =0x8728 =34600(-30936) [Jump direct]
87da:D87DA SUB   Y,A        ; [Y - A -> A]
87dc:      BM    D87D7      ; =-7 [Branch on minus]
87de:      XFR   X,A        ; [Transfer X to A]
87e0:      SLA              ; [Left shift A]
87e1:      IVA              ; [Invert A]
87e2:      INA              ; [Increment A]
87e3:      LDB=  X'C000'    ; =0xc000 =49152(-16384) ='@',NUL [Load B with immediate]
87e6:      ADD   B,A        ; [B + A -> A]
87e8:      LDA+  A          ; [Load A from address in A]
87e9:      XFR   B,S        ; [Transfer B to S]
87eb:      LDX=  X'8001'    ; =0x8001 =32769(-32767) [Load X with immediate]
87ee:      LDB=  X'F800'    ; =0xf800 =63488(-2048) ='x',NUL [Load B with immediate]
87f1:      NAB              ; [A & B -> B]
87f2:      XFR   B,Z        ; [Transfer B to Z]
87f4:      STAB/ X'F10E'    ; =0xf10e =61710(-3826) [Store AL direct]
87f7:      JMP+  A          ; [Jump indexed, direct]
*
87f9:      DW    X'3E00'    ; =0x3e00 =15872
87fb:      DB    0,5        ; =0x00,0x0005
8800:ENDPT
